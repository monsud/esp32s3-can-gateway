## Kconfig.projbuild
```kconfig
menu "CAN Gateway Configuration"

    config WIFI_SSID
        string "WiFi SSID"
        default "AREA1"

    config WIFI_PASSWORD
        string "WiFi Password"
        default "P4ssword@01"

    config MQTT_BROKER_URI
        string "MQTT Broker URI"
        default "mqtt://broker.hivemq.com:1883"

    config MQTT_CLIENT_ID
        string "MQTT Client ID"
        default "esp32s3-can-gateway"

    config MQTT_TOPIC_TELEMETRY
        string "MQTT Telemetry Topic"
        default "cangateway/telemetry"

    config MQTT_TOPIC_INJECT
        string "MQTT Inject Topic"
        default "cangateway/inject"

    config MQTT_TOPIC_ALARM
        string "MQTT Alarm Topic"
        default "cangateway/alarm"

    config TWAI_TX_GPIO
        int "TWAI TX GPIO"
        default 5

    config TWAI_RX_GPIO
        int "TWAI RX GPIO"
        default 6

    config TWAI_BAUDRATE_KBPS
        int "TWAI Baudrate (kbps): 250 or 500"
        default 500

    config SPIFFS_LOG_PATH
        string "SPIFFS Log File Path"
        default "/spiffs/can_log.txt"

    config SPIFFS_MAX_SIZE_KB
        int "SPIFFS Max Log Size (KB) before rotation"
        default 64

    config MONITOR_PRINT_INTERVAL_MS
        int "Monitor print interval (ms)"
        default 5000

endmenu
```

## sdkconfig.defaults
```kconfig
CONFIG_ESP_TASK_WDT=y
CONFIG_FREERTOS_HZ=1000
CONFIG_MQTT_PROTOCOL_311=y
CONFIG_SPIFFS_USE_MAGIC=y
CONFIG_TWAI_ISR_IN_IRAM=y
```
